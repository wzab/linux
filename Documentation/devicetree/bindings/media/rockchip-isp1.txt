## Documentation/devicetree/bindings/media/rockchip-isp1.txt
```
Rockchip SoC Image Signal Processing unit v1
----------------------------------------------

Rockchip ISP1 is the Camera interface for the Rockchip series of SoCs
which contains image processing, scaling, and compression funcitons.

Required properties:
- compatible: value should be one of the following
	"rockchip,rk3288-cif-isp";
	"rockchip,rk3399-cif-isp";
- reg : offset and length of the register set for the device.
- interrupts: should contain ISP interrupt.
- clocks: phandle to the required clocks.
- clock-names: required clock name.
- iommus: required a iommu node.
- phys: the phandle for the PHY port
- phy-names: must contain "dphy"

port node
-------------------

The device node should contain one 'ports' child node, with children 'port'
with child 'endpoint'.
nodes, according to the bindings defined in Documentation/devicetree/bindings/
media/video-interfaces.txt.

- endpoint(mipi):
	- remote-endpoint: Connecting to Rockchip MIPI-DPHY,
		which is defined in rockchip-mipi-dphy.txt.

The port node must contain at least one endpoint, either parallel or mipi.
It could have multiple endpoints, but please note the hardware don't support
two sensors work at a time, they are supposed to work asynchronously.

Device node example
-------------------

	isp0: isp0@ff910000 {
		compatible = "rockchip,rk3399-cif-isp";
		reg = <0x0 0xff910000 0x0 0x4000>;
		interrupts = <GIC_SPI 43 IRQ_TYPE_LEVEL_HIGH 0>;
		clocks = <&cru SCLK_ISP0>,
			 <&cru ACLK_ISP0>, <&cru ACLK_ISP0_WRAPPER>,
			 <&cru HCLK_ISP0>, <&cru HCLK_ISP0_WRAPPER>;
		clock-names = "clk_isp",
			      "aclk_isp", "aclk_isp_wrap",
			      "hclk_isp", "hclk_isp_wrap";
		power-domains = <&power RK3399_PD_ISP0>;
		iommus = <&isp0_mmu>;
		phys = <&dphy>;
		phy-names = "dphy";

		ports {
			#address-cells = <1>;
			#size-cells = <0>;

			port@0 {
				mipi_in_wcam: endpoint@0 {
					reg = <0>;
					remote-endpoint = <&wcam_out>;
					data-lanes = <1 2>;
				};

				mipi_in_ucam: endpoint@1 {
					reg = <1>;
					remote-endpoint = <&ucam_out>;
					data-lanes = <1>;
				};
			};
		};
	};
```

## Documentation/devicetree/bindings/media/rockchip-mipi-dphy.txt
```
Rockchip SoC MIPI RX D-PHY
-------------------------------------------------------------

Required properties:
- compatible: value should be one of the following
	"rockchip,rk3288-mipi-dphy"
	"rockchip,rk3399-mipi-dphy"
- clocks : list of clock specifiers, corresponding to entries in
	clock-names property;
- clock-names: required clock name.
- #phy-cells: Number of cells in a PHY specifier; Should be 0.

MIPI RX D-PHY use registers in "general register files", it
should be a child of the GRF.
MIPI TXRX D-PHY have its own registers, it must have a reg property.

Optional properties:
- reg: offset and length of the register set for the device.
- rockchip,grf: MIPI TX1RX1 D-PHY not only has its own register but also
		the GRF, so it is only necessary for MIPI TX1RX1 D-PHY.

Device node example
-------------------

grf: syscon@ff770000 {
	compatible = "rockchip,rk3399-grf", "syscon", "simple-mfd";

...

	dphy: mipi-dphy {
		compatible = "rockchip,rk3399-mipi-dphy";
		clocks = <&cru SCLK_MIPIDPHY_REF>,
			<&cru SCLK_DPHY_RX0_CFG>,
			<&cru PCLK_VIO_GRF>;
		clock-names = "dphy-ref", "dphy-cfg", "grf";
		power-domains = <&power RK3399_PD_VIO>;
		#phy-cells = <0>;
	};
};
```

## drivers/staging/media/phy-rockchip-dphy/Kconfig
```kconfig
# SPDX-License-Identifier: GPL-2.0-only
#
# Phy drivers for Rockchip platforms
#
config PHY_ROCKCHIP_DPHY
	tristate "Rockchip MIPI Synopsys DPHY driver"
	depends on (ARCH_ROCKCHIP || COMPILE_TEST) && OF
	select GENERIC_PHY_MIPI_DPHY
	select GENERIC_PHY
	help
	  Enable this to support the Rockchip MIPI Synopsys DPHY.
```
